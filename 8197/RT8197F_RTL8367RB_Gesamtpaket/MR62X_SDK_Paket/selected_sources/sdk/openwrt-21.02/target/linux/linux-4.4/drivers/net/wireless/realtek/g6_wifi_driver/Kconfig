## 8197/RT8197F_RTL8367RB_Gesamtpaket/MR62X_SDK_Paket/selected_sources/sdk/openwrt-21.02/target/linux/linux-4.4/drivers/net/wireless/realtek/g6_wifi_driver/Kconfig
```kconfig
menuconfig RTLWIFI6
	tristate "Realtek PCIE WiFi6"
	depends on PCIE || PCI
	select WIRELESS_EXT
	select WEXT_PRIV
	help
	  Help message of RTLWIFI6

if RTLWIFI6

menu "Realtek PCIE WiFi6 Chip"
	config RTL8852AE
	bool "RTL8852AE"

	config RTL8852CE
	bool "RTL8852CE"

	config RTL8832BR
	bool "RTL8832BR"

	config RTL8192XB
	bool "RTL8192XB"
endmenu

config RTW_LINK_PHL_MASTER
	bool "Link to phl master branch"
	default n
	help
	  During updating changes to phl master. Some code needs to be disabled 
	  before corresponding PHL changed commited to PHL.

config RTW_DRV_HAS_NVM
	bool "Driver to support system NVM instead efuse"
	default y
	help
	   System's NVM, instead of wifi chip's efuse, stores MP calibration 
	   values and system configuration. 

config RTW_PERSIST_IF
	bool "Persist interface"
	default n
	help
	  Once virtual interface is created, it remain alive until primary one is deleted.

config LIMITED_AP_NUM
	int "AP interface number"
	range 1 14
	default 6
	help
	  Maximum number of AP interface the Realtek Wifi6 driver to support

source "drivers/net/wireless/realtek/g6_wifi_driver/Kconfig.wfo"

config 2G_ON_WLAN0
	bool "Config 2.4G on wlan0 & 5G on wlan1"
	depends on PCIE || PCI
	default n
	help
	  Help message of RTLWIFI6

config 2G_ON_PCIE_SLOT0
	bool "Config 2.4G on pcie slot 0 & 5G on pcie slot 1"
	depends on PCIE || PCI
	default n
	help
	  Help message of RTLWIFI6

config SHARE_XSTAL
	bool "Realtek WiFi share xstal"
	default y
	help
	  WiFi 5G shares the xstal with 2.4G

choice
	prompt "XSTAL Type for WiFi 2.4G"
	depends on !SHARE_XSTAL
	default 2G_40MHZ_XSTAL

	config 2G_25MHZ_XSTAL
	bool "25MHz xstal - share with SoC"

	config 2G_40MHZ_XSTAL
	bool "40MHz xstal"
endchoice

config AX_SHARE_XTAL
	bool "AX shared crystal config"
	default n
	help
	  Device is shared crystal
choice
	prompt "shared crystal type"
	depends on AX_SHARE_XTAL

	config WLAN_SHARE_XTAL
	bool "Wlan 2.4G shared xtal with 5G"

endchoice

config RTW_DEV_IS_SINGLE_BAND
	bool "Wlan device is single band"
	default y
	help
	  Realtek Wlan device is designed for either 2.4G or 5G band.

config RTW_2_4G_DEV
	string "PCI device's name of 2.4G band" if RTW_DEV_IS_SINGLE_BAND
	default "0000:02:01.0"
	help
	  PCI device name that supports 2.4G band. Default value is set for 98D reference board design.

config MP_INCLUDED
	bool "Realtek PCIE WiFi MP Mode"
	depends on PCIE || PCI
	default y
	help
	  Help message of RTLWIFI6

config PHL_TEST_SUITE
	bool "Realtek PCIE WiFi MP Test Suite"
	depends on MP_INCLUDED
	default y
	help
	  Help message of RTLWIFI6

config MP_CONFIG_FOR_AP
	bool "Enable config setting for AP's MP mode"
	depends on MP_INCLUDED
	default y
	help
	  Help message of RTLWIFI6

# RFE type config

choice
	prompt "RFE Type for WLAN0"
	default WLAN0_RFE_TYPE_50

	config WLAN0_RFE_TYPE_50
	bool "Type 50"

	config WLAN0_RFE_TYPE_51
	bool "Type 51"

	config WLAN0_RFE_TYPE_52
	bool "Type 52"

	config WLAN0_RFE_TYPE_53
	bool "Type 53"

	config WLAN0_RFE_TYPE_54
	bool "Type 54"
endchoice

# WLAN0 extension para config for eFEM
choice
	prompt "FEM Type for WLAN0"
		default WLAN0_AP_5G
		depends on WLAN0_RFE_TYPE_50 || WLAN0_RFE_TYPE_51 || WLAN0_RFE_TYPE_52 || WLAN0_RFE_TYPE_53 || WLAN0_RFE_TYPE_54

		config WLAN0_AP_5G
		bool "AP (5G)"
		depends on WLAN0_RFE_TYPE_50

		config WLAN0_AP_2G
		bool "AP (2G)"
		depends on WLAN0_RFE_TYPE_50

if RTL8852AE
		config WLAN0_FEM_VC5333
		bool "VC5333 (2G)"
		depends on WLAN0_RFE_TYPE_51

		config WLAN0_FEM_SKY85333
		bool "SKY85333 (2G)"
		depends on WLAN0_RFE_TYPE_51

		config WLAN0_FEM_SKY85747
		bool "SKY85747 (5G)"
		depends on WLAN0_RFE_TYPE_51

		config WLAN0_FEM_RTC66204
		bool "RTC66204 (2G)"
		depends on WLAN0_RFE_TYPE_52

		config WLAN0_FEM_RTC66504
		bool "RTC66504 (5G)"
		depends on WLAN0_RFE_TYPE_52

		config WLAN0_FEM_KCT8575HE
		bool "KCT8575HE"
		depends on WLAN0_RFE_TYPE_53

		config WLAN0_FEM_RTC7676E
		bool "RTC7676E"
		depends on WLAN0_RFE_TYPE_54
endif

if RTL8852CE
		config WLAN0_FEM_SKY85791
		bool "SKY85791 (8852CRe)"
		depends on WLAN0_RFE_TYPE_51

		config WLAN0_FEM_KTC8570N
		bool "KTC8570N (8852CRe)"
		depends on WLAN0_RFE_TYPE_51

		config WLAN0_FEM_RTC66506
		bool "RTC66506 (8852CRe)"
		depends on WLAN0_RFE_TYPE_52

		config WLAN0_FEM_RTC7676D
		bool "RTC7676D (8852CRe)"
		depends on WLAN0_RFE_TYPE_54

		config WLAN0_FEM_RTC7676D_08U
		bool "RTC7676D_08U (8852CRe)"
		depends on WLAN0_RFE_TYPE_54
endif

if RTL8192XB
		config WLAN0_FEM_SKY85340
		bool "SKY85340 (8192XBe)"
		depends on WLAN0_RFE_TYPE_51

		config WLAN0_FEM_VC5337
		bool "VC5337 (8192XBe)"
		depends on WLAN0_RFE_TYPE_53

		config WLAN0_FEM_RTC7646
		bool "RTC7646 (8192XBe)"
		depends on WLAN0_RFE_TYPE_54
endif
endchoice


choice
	prompt "RFE Type for WLAN1"
	default WLAN1_RFE_TYPE_50

	config WLAN1_RFE_TYPE_50
	bool "Type 50"

	config WLAN1_RFE_TYPE_51
	bool "Type 51"

	config WLAN1_RFE_TYPE_52
	bool "Type 52"

	config WLAN1_RFE_TYPE_53
	bool "Type 53"

	config WLAN1_RFE_TYPE_54
	bool "Type 54"

endchoice

# WLAN1 extension para config for eFEM
choice
	prompt "FEM Type for WLAN1"
		default WLAN1_AP_2G
		depends on WLAN1_RFE_TYPE_50 || WLAN1_RFE_TYPE_51 || WLAN1_RFE_TYPE_52 || WLAN1_RFE_TYPE_53 || WLAN1_RFE_TYPE_54

		config WLAN1_AP_5G
		bool "AP (5G)"
		depends on WLAN1_RFE_TYPE_50

		config WLAN1_AP_2G
		bool "AP (2G)"
		depends on WLAN1_RFE_TYPE_50

if RTL8852AE
		config WLAN1_FEM_VC5333
		bool "VC5333 (2G)"
		depends on WLAN1_RFE_TYPE_51

		config WLAN1_FEM_SKY85333
		bool "SKY85333 (2G)"
		depends on WLAN1_RFE_TYPE_51

		config WLAN1_FEM_SKY85747
		bool "SKY85747 (5G)"
		depends on WLAN1_RFE_TYPE_51

		config WLAN1_FEM_RTC66204
		bool "RTC66204 (2G)"
		depends on WLAN1_RFE_TYPE_52

		config WLAN1_FEM_RTC66504
		bool "RTC66504 (5G)"
		depends on WLAN1_RFE_TYPE_52

		config WLAN1_FEM_KCT8575HE
		bool "KCT8575HE"
		depends on WLAN1_RFE_TYPE_53

		config WLAN1_FEM_RTC7676E
		bool "RTC7676E"
		depends on WLAN1_RFE_TYPE_54
endif

if RTL8852CE
		config WLAN1_FEM_SKY85791
		bool "SKY85791 (8852CRe)"
		depends on WLAN1_RFE_TYPE_51

		config WLAN1_FEM_KTC8570N
		bool "KTC8570N (8852CRe)"
		depends on WLAN1_RFE_TYPE_51

		config WLAN1_FEM_RTC66506
		bool "RTC66506 (8852CRe)"
		depends on WLAN1_RFE_TYPE_52

		config WLAN1_FEM_RTC7676D
		bool "RTC7676D (8852CRe)"
		depends on WLAN1_RFE_TYPE_54

		config WLAN1_FEM_RTC7676D_08U
		bool "RTC7676D_08U (8852CRe)"
		depends on WLAN1_RFE_TYPE_54
endif

if RTL8192XB
		config WLAN1_FEM_SKY85340
		bool "SKY85340 (8192XBe)"
		depends on WLAN1_RFE_TYPE_51

		config WLAN1_FEM_VC5337
		bool "VC5337 (8192XBe)"
		depends on WLAN1_RFE_TYPE_53

		config WLAN1_FEM_RTC7646
		bool "RTC7646 (8192XBe)"
		depends on WLAN1_RFE_TYPE_54
endif
endchoice

config 24G_256QAM
	bool "Enable 256 QAM on 2.4G"
        default n

config RTW_80211W_SUPPORT
	bool "Enable WiFi6 80211W"
        default y

config WIFI6_WPA3
	bool "Enable WiFi6 WPA3"
        default y

config RTW_CLIENT_MODE_SUPPORT
        bool "Client Mode Support"
        depends on PCIE || PCI
        default n
        help
          Help message of RTLWIFI6

config RTW_REPEATER_MODE_SUPPORT
        bool "Repeater Mode Support"
        depends on PCIE || PCI
	select RTW_CLIENT_MODE_SUPPORT
        default n
        help
          Help message of RTLWIFI6

config RTW_A4_STA
    bool "A4_STA support"
    default n
    help
        Help message of RTLWIFI6

config APPEND_VENDOR_IE_ENABLE
    bool

config WLAN_EVENT_INDICATE_GENL
    bool

config RTK_WLAN_EVENT_INDICATE
	bool "Wlan event indicate support"
	depends on !WLAN_EVENT_INDICATE_GENL
	default n
	help
	    Help message of RTLWIFI6

config RTW_SBWC
	bool "station bandwidth control support"
	default n
	help
	    Help message of RTLWIFI6

config RTW_GBWC
	bool "group bandwidth control support"
	default n
	help
	    Help message of RTLWIFI6

config AP_NEIGHBOR_INFO
        bool "Wlan ap neighbor info support"
        default n
        help
            Help message of RTLWIFI6

config RTW_CURRENT_RATE_ACCOUNTING
        bool "current_rate_accounting_support"
        default n
        help
            Help message of RTLWIFI6

config RTW_MULTI_AP
    bool "Multi-AP Support"
    select RTW_A4_STA
    select RTW_CLIENT_MODE_SUPPORT
	select RTW_80211K
	select RTW_80211V
    default n
    help
        Help message of RTLWIFI6

config RTW_MULTI_AP_R1
	depends on RTW_MULTI_AP
    bool "Muti-AP Profile 1"
	default y

config RTW_MULTI_AP_R2
depends on RTW_MULTI_AP
    bool "Muti-AP Profile 2"
	select RTW_MULTI_AP_R1

config RTW_MULTI_AP_R3
depends on RTW_MULTI_AP
    bool "Muti-AP Profile 3"
	select RTW_MULTI_AP_R2

config RTW_MULTI_AP_LOGO
    bool "Multi-AP Logo Mode"
	depends on RTW_MULTI_AP
	default n

config RTW_80211K
    bool "802.11K Support"
    default n
    help
        Help message of RTLWIFI6

config RTW_80211V
    bool "802.11V Support"
    default n
    help
        Help message of RTLWIFI6

config RTW_80211R
    bool "802.11R Support"
    default n
    help
        Help message of RTLWIFI6

config RTW_OWE
    bool "OWE Support"
    default n
    help
	Help message of RTLWIFI6

config WLAN_MANAGER
	bool "Realtek WLAN Manager support"
	default n
	help
	  Help message of RTLWIFI6

config BAND_STEERING
	bool "Realtek Band Steering suuport"
	default n
	select WLAN_MANAGER
	help
	  Help message of RTLWIFI6
config RTW_CROSSBAND_REPEATER_SUPPORT
	bool "Realtek crossband repeater support"
	default n
	select WLAN_MANAGER
	help
	  Help message of RTLWIFI6

config RTW_COMMON_NETLINK
	bool "Common Netlink Support"
	default n
	select RTW_MULTI_AP
	select WLAN_MANAGER
	help
	  Help message of RTLWIFI6

config SLOT_1_TX_BEAMFORMING
    bool "TX_BEAMFORMING Support"
    default n
    help
        Help message of RTLWIFI6

config RECORD_CLIENT_HOST
	bool "Record client host support"
        default n
	help
            Help message of RTLWIFI6

config RTW_SSID_PRIORITY
	bool "ssid priority support"
	default n
        help
            Help message of RTLWIFI6

config CTC_FEATURE
	bool "Realtek 8852A CTC feature support"
	select WLAN_EVENT_INDICATE_GENL
	select APPEND_VENDOR_IE_ENABLE
	default n
	help
		Help message of RTLWIFI6

config RTW_OPCLASS_CHANNEL_SCAN
        bool "Wlan opClass channel scan"
        default n
        help
            Help message of RTLWIFI6

config RTW_DE_SUPPORT
        bool "Data Element driver support"
        default n
        help
            Support Wi-Fi Alliance Data Element in driver

config RTL_CFG80211_WAPI_SUPPORT
	bool "RTL cfg80211 WAPI support"
	default n

config WIFI_LED_SHARE_WITH_WPS
	bool "WiFi LED share with WPS"
        default n
	help
            Help message of RTLWIFI6

config RTW_BYPASS_DEAMSDU
	bool "Bypass de-AMSDU support"
	default n
endif
```

## 8197/backports/src/drivers/net/wireless/mediatek/mt76/mt7615/Kconfig
```kconfig
# SPDX-License-Identifier: GPL-2.0-only
config MT7615E
	depends on !KERNEL_4_2
	tristate "MediaTek MT7615E (PCIe) support"
	depends on m
	select MT76_CORE
	depends on MAC80211
	depends on PCI
	help
	  This adds support for MT7615-based wireless PCIe devices.
```

## GPL_ MR62X/sdk/openwrt-21.02/package/backports/src/drivers/net/wireless/mediatek/mt76/mt76x0/Kconfig
```kconfig
# SPDX-License-Identifier: GPL-2.0-only
config MT76x0_COMMON
	tristate
	depends on m
	select MT76x02_LIB

config MT76x0U
	depends on !KERNEL_4_2
	tristate "MediaTek MT76x0U (USB) support"
	depends on m
	select MT76x0_COMMON
	select MT76x02_USB
	depends on MAC80211
	depends on USB
	help
	  This adds support for MT7610U-based wireless USB dongles.

config MT76x0E
	depends on !KERNEL_4_2
	tristate "MediaTek MT76x0E (PCIe) support"
	depends on m
	select MT76x0_COMMON
	depends on MAC80211
	depends on PCI
	help
	  This adds support for MT7610/MT7630-based wireless PCIe devices.
```

## GPL_ MR62X/sdk/openwrt-21.02/package/backports/src/drivers/net/wireless/realtek/Kconfig
```kconfig
# SPDX-License-Identifier: GPL-2.0-only
config WLAN_VENDOR_REALTEK
	bool "Realtek devices"
	default y
	---help---
	  If you have a wireless card belonging to this class, say Y.

	  Note that the answer to this question doesn't directly affect the
	  kernel: saying N will just cause the configurator to skip all the
	  questions about these cards. If you say Y, you will be asked for
	  your specific card in the following questions.

config WLAN_8192FE
	bool "WLAN_8192FE support"
	default n

if WLAN_VENDOR_REALTEK

config THER_CTRL
	tristate "Realtek thermal control support"
	default n
	depends on RTL8852AE || WLAN_8192FE
	---help---
	Realtek thermal control support.

source "drivers/net/wireless/realtek/rtl818x/Kconfig"
source "drivers/net/wireless/realtek/rtlwifi/Kconfig"
source "drivers/net/wireless/realtek/rtl8xxxu/Kconfig"
source "drivers/net/wireless/realtek/rtw88/Kconfig"
source "drivers/net/wireless/realtek/g6_wifi_driver/Kconfig"
if WLAN_8192FE
source "drivers/net/wireless/realtek/rtl8192fe/Kconfig"
source "drivers/net/wireless/realtek/rtl8197g/Kconfig.usdk120h"
endif

endif # WLAN_VENDOR_REALTEK
```

## GPL_ MR62X/sdk/openwrt-21.02/target/linux/linux-4.4/drivers/net/wireless/realtek/g6_wifi_driver/script/config.in
```kconfig
#
# For a description of the syntax of this configuration file,
# see Documentation/kbuild/config-language.txt.
# -a: and -o: or !: NOT
# 
 
mainmenu_name "RTL871X Configuration"

choice 'Configure Chip Version(0:8711, 1:8712)' \
        "0 CONFIG_RTL8711 \
         1 CONFIG_RTL8712 "

choice 'Configure HCI Interface(0:SDIO, 1:USB)' \
        "0 CONFIG_SDIO_HCI \
         1 CONFIG_USB_HCI"
if [ "$CONFIG_RTL8711" = "y" ] ;	then
	if [ "$CONFIG_SDIO_HCI" = "y" ] ;	then
	define_string 'RTL871X_MODULE_NAME' "module_rtl8711_sdio"
	fi
	
	if [ "$CONFIG_USB_HCI" = "y" ] ; then
	define_string 'RTL871X_MODULE_NAME' "module_rtl8711_usb"
	fi		
fi
if [ "$CONFIG_RTL8712" = "y" ] ; then
	if [ "$CONFIG_SDIO_HCI" = "y" ] ; then
	define_string 'RTL871X_MODULE_NAME' "module_rtl8712_sdio"
	fi
	
	if [ "$CONFIG_USB_HCI" = "y" ] ; then
	define_string 'RTL871X_MODULE_NAME' "module_rtl8712_usb"
	fi		
fi
      
choice 'Configure Windows Platform(0:Windows, 1:Linux)' \
        "0 PLATFORM_WINDOWS \
         1 PLATFORM_LINUX"      

if [ "$PLATFORM_WINDOWS" = "y" ]; then
	choice 'Windows-Based OS(0:XP, 1:CE)' \
        "0 PLATFORM_OS_XP \
         1 PLATFORM_OS_CE"
fi

if [ "$PLATFORM_LINUX" = "y" ]; then
	choice 'Linux-Based OS(0:CONFIG_PLATFORM_I386_PC, 1:CONFIG_PLATFORM_ARM_S3C,2:CONFIG_PLATFORM_RTD2880B)' \
        "0 CONFIG_PLATFORM_I386_PC \
         1 CONFIG_PLATFORM_ARM_S3C \
         2 CONFIG_PLATFORM_RTD2880B"
fi
choice 'Need Debug Message(0:No, 1:Yes)' \
        "0 NO_CONFIG_DEBUG_RTL871X \
         1 CONFIG_DEBUG_RTL871X"    

choice 'Target Platform Endian(0:LITTLE_ENDIAN, 1:BIG_ENDIAN)' \
        "0 CONFIG_LITTLE_ENDIAN \
         1 CONFIG_BIG_ENDIAN"         
         
choice 'Need Power Control Function(0:No, 1:Yes)' \
        "0 NO_CONFIG_PWRCTRL \
         1 CONFIG_PWRCTRL"       
         
choice 'Enable Mass Production Code(0:No, 1:Yes)' \
        "0 NO_CONFIG_MP_INCLUDED \
         1 CONFIG_MP_INCLUDED"   
         
choice 'Use Internal Firmware Image(0:No, 1:Yes)' \
        "0 NO_CONFIG_EMBEDDED_FWIMG \
         1 CONFIG_EMBEDDED_FWIMG"               
         
if [ "$CONFIG_RTL8712" = "y" ]; then
	choice 'Support 802.11N(0:No, 1:Yes)' \
        "0 NO_CONFIG_80211N_HT \
         1 CONFIG_80211N_HT"  
         
	choice 'Enable Recv Reorder Control(0:No, 1:Yes)' \
        "0 NO_CONFIG_RECV_REORDERING_CTRL \
         1 CONFIG_RECV_REORDERING_CTRL"             
         
         
fi         
```
