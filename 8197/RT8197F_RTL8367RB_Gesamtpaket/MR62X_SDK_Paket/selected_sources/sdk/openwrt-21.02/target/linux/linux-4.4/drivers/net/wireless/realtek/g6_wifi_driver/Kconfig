## GPL_ MR62X/sdk/openwrt-21.02/target/linux/linux-4.4/tplink/Kconfig
```kconfig
menu "TP-LINK kernel features"
config SFE_PPP_HEADER
        bool "kernel support for sfe ppp header build"
        default n
        help
          Say 'y' here if want to enable ppp header building for sfe

config SFE_TUNNEL_HEADER
        bool "kernel support for sfe tunnel header build"
        default n
        help
          Say 'y' here if want to enable tunnel header building for sfe

config TP_BRIDGE
        bool "kernel support for tplink hyfi-bridge"
        default n
        help
          Say 'y' here if want to enable hyfi-bridge

endmenu
```

## GPL_ MR62X/sdk/openwrt-21.02/tools/Config.in
```kconfig
# Copyright (C) 2006-2013 OpenWrt.org
#
# This is free software, licensed under the GNU General Public License v2.
# See /LICENSE for more information.
#

menuconfig EXTERNAL_HOSTTOOL
	bool
	default n
	prompt "Use external host tool" if DEVEL
	help
	  If enabled, external host tool is used.
	  NOTE!!!The external host tool should be put in TOPDIR/staging_dir/host!!!
	  Other dir is not supported!
```

## GPL_AX12v1/Iplatform/openwrt/package/broadcom-wl/Config.in
```kconfig
config BCM_SDK6X
	bool "use BCM SDK6.X"
	default n
    depends PACKAGE_kmod-brcm-wl

config BCM_SDK7X
	bool "use BCM SDK7.X"
	default n
    depends PACKAGE_kmod-brcm-wl

config BCM_WL_STA_INFO_VER
	int "config BCM's sta_info version(WL_STA_VER)"
	default 4
    depends BCM_SDK7X
```

## GPL_AX12v1/Iplatform/openwrt/package/iwinfo/Config.in
```kconfig
menu "General Configuration"

config PACKAGE_WIFI_DBDC_MODE
	bool "if wifi works in DBDC mode."
	default n
	help
		This is config for wifi dbdc.

if PACKAGE_WIFI_DBDC_MODE
config PACKAGE_WIFI_DBDC_CHIP_TYPE
	string "type of wifi chip working in DBDC mode."
	default ""
	help
		This is config for type of wifi chip working in DBDC mode	
endif

config IWINFO_DFS_CHANNEL_SUPPORT
	bool "if support DFS Channels."
	default n
	help
		This is config for channel show when wifi disabled.

config IWINFO_WIFI_TRIBAND
	bool "if wifi support TriBand."
	default n
	help
		This is config for wifi TriBand.

config IWINFO_DOT11_EHT_BE
	bool "if wifi support 11be."
	default n
	help
		This is config for wifi 11be.

config USE_SDK_NL_TINY
	bool "if use SDK nl-tiny."
	default n
	help
		This is config for SDK nl-tiny using.

endmenu
```

## GPL_AX12v1/Iplatform/packages/opensource/minidlna/Config.in
```kconfig
config PACKAGE_MINIDLNA_GUEST_NETWORK_LIMIT
    	bool "limit guest network access"
    	default n
    	help 
        	Feature: minidlna limit guest network access
```

## GPL_AX12v1/Iplatform/packages/opensource/proftpd/Config.in
```kconfig
config proftpd-in-fit
	bool "reduce proftpd"
	default n
	depends PACKAGE_proftpd
	help
	  Feature: cut off some optionsal features of proftpd.

config proftpd-limit-guest-ubus
    bool "limit guest network access"
    default n
    depends PACKAGE_proftpd
    help 
        Feature: proftpd limit guest network access
```

## GPL_AX12v1/Iplatform/packages/opensource/snort/Config.in
```kconfig
menu "Configuration"
	depends on PACKAGE_snort

config SNORT_LZMA
	bool "Enable LZMA support"
	default n
	help
           This option enables LZMA decompression.
           Disabled by default.

config PACKAGE_SNORT_SUPPORT_IPV6
        bool "support IPV6 protection"
        depends PACKAGE_snort
        default n
endmenu
```

## GPL_AX12v1/rtl8197/backports-5.2.8-1/drivers/net/wireless/mediatek/mt76/mt7603/Kconfig
```kconfig
# SPDX-License-Identifier: GPL-2.0-only
config MT7603E
	depends on !KERNEL_4_2
	tristate "MediaTek MT7603E (PCIe) and MT76x8 WLAN support"
	depends on m
	select MT76_CORE
	depends on MAC80211
	depends on PCI
	help
	  This adds support for MT7603E wireless PCIe devices and the WLAN core on
	  MT7628/MT7688 SoC devices
```

## GPL_AX12v1/rtl8197/linux-4.4/drivers/net/wireless/realtek/g6_wifi_driver/Kconfig.wfo
```kconfig
config WFO_VIRT
	tristate "Realtek WFO VIRT driver"
	default n
	help
	Realtek WFO VIRT driver.

if WFO_VIRT
	config WFO_VIRT_DEVNAME
		string "WFO virtual driver's name"
		default "wlan"
		help
		  WFO virtual driver's name

	choice
		prompt "WiFi Offload Interface"
		default WFO_OFFLOAD_2G

		config WFO_OFFLOAD_2G
			bool "Offload 2G WiFi"

		config WFO_OFFLOAD_5G
			bool "Offload 5G WiFi"
	endchoice
endif

choice
	prompt "IPC Destination"
	depends on WFO_VIRT
	default WFO_VIRT_IPC_TO_PE

	config WFO_VIRT_IPC_TO_PE
		bool "Send to PE"

	config WFO_VIRT_SAME_CPU
		bool "Run on Linux"
endchoice

choice
	prompt "PHL Version"
	depends on WFO_VIRT
	default PHL_AP_BRANCH_V1_2_3

	config PHL_AP_BRANCH_V1_2_3
		bool "ap/branch/v1.2.3"

	config AP_015_52C_DEVP
		bool "ap/015_52c_devp"
endchoice
```

## GPL_AX12v1/rtl8197/linux-4.4/drivers/net/wireless/realtek/ther_ctrl/Kconfig
```kconfig
config THER_CONTROL
	tristate "Realtek thermal control support"
	default n
	---help---
	Realtek thermal control support.
```

## wlan_ethernet_switch_extracted_full/wlan_ethernet_switch_extracted_files/sdk/openwrt-21.02/target/linux/linux-4.4/drivers/net/wireless/realtek/ther_ctrl/Kconfig
```kconfig
config THER_CTRL
	tristate "Realtek thermal control support"
	default n
	---help---
	Realtek thermal control support.
```
