## rtk-ms-uClinux-src-2.6.19-2.6.32.58-svn53590.tar.gz_extracted/kernel/uClinux/linux-2.6.32.x/arch/rlx/Kconfig.rlx
```kconfig
#
# Realtek Semiconductor Corp.
#
# RLX Linux Kernel Configuration
#
# Tony Wu (tonywu@realtek.com)
# Dec. 07, 2008
#

source "../target/selection/config.cpu"
source "../target/selection/config.in"

#
# RLX
#
config RLX
	bool
	default y
	select BOOT_ELF32
	select DMA_NONCOHERENT
	select SYS_SUPPORTS_ARBIT_HZ
	select SYS_HAS_EARLY_PRINTK

config MACH_RLX
	bool
	default y
	select CPU_SUPPORTS_32BIT_KERNEL
	select SYS_SUPPORTS_32BIT_KERNEL
	select SYS_SUPPORTS_LITTLE_ENDIAN if ARCH_CPU_EL
	select SYS_SUPPORTS_BIG_ENDIAN if ARCH_CPU_EB
	select IRQ_CPU if ARCH_IRQ_CPU
	select IRQ_VEC if ARCH_IRQ_VEC
	select IRQ_GIC if ARCH_IRQ_GIC
	select HW_HAS_PCI if (ARCH_BUS_PCI && BSP_ENABLE_PCI)
	select HW_HAS_USB if (ARCH_BUS_USB && BSP_ENABLE_USB)
	select ARCH_SUPPORTS_MSI if (ARCH_BUS_PCI_MSI && BSP_ENABLE_PCI)
	select CPU_HAS_WMPU if (ARCH_CPU_WMPU && BSP_ENABLE_WMPU)
	select CPU_HAS_SYNC if ARCH_CPU_SYNC

#
# CPU
#
config CPU_RLX4181
	bool
	default y if ARCH_CPU_RLX4181

config CPU_RLX5181
	bool
	default y if ARCH_CPU_RLX5181

config CPU_RLX5280
	bool
	default y if ARCH_CPU_RLX5280

config CPU_RLX4281
	bool
	select CPU_HAS_BUS_ERROR
	default y if ARCH_CPU_RLX4281

config CPU_RLX5281
	bool
	select CPU_HAS_BUS_ERROR
	default y if ARCH_CPU_RLX5281

config CPU_HAS_RADIAX
	bool
	default y if ARCH_CPU_RADIAX

config CPU_HAS_SLEEP
	bool
	default y if ARCH_CPU_SLEEP

config CPU_HAS_ULS
	bool
	default y if ARCH_CPU_ULS

config CPU_HAS_TLS
	bool
	default y if ARCH_CPU_TLS && BSP_ENABLE_TLS

config CPU_HAS_LLSC
	bool
	default y if ARCH_CPU_LLSC

config CPU_HAS_BUS_ERROR
	bool

config CPU_HAS_WMPU
	bool
	select HARDWARE_WATCHPOINTS

#
# IRQ
#
config IRQ_VEC
	bool

#
# Timer
#
config CEVT_EXT
	bool
	default y if ARCH_CEVT_EXT
	default y if !CPU_RLX4281 && !CPU_RLX5281

config CEVT_RLX
	bool
	default y if ARCH_CEVT_RLX
	default n if !CPU_RLX4281 && !CPU_RLX5281

config CSRC_RLX
	bool
	default y if ARCH_CEVT_RLX
	default n if !CPU_RLX4281 && !CPU_RLX5281

#
# CACHE
#
config CPU_HAS_WBC
	bool
	default y if ARCH_CACHE_WBC

config CPU_HAS_L2C
	bool
	default y if ARCH_CACHE_L2C

config CPU_HAS_WBIC
	bool
	default y if ARCH_CACHE_WBIC

#
# BUS
#
config HW_HAS_USB
	bool
```

## rtk-ms-uClinux-src-2.6.19-2.6.32.58-svn53590.tar.gz_extracted/kernel/uClinux/linux-2.6.x/arch/mips/Kconfig.realtek
```kconfig
#
# Realtek software solution
#

menu "Realtek software solution"

choice
	prompt "System chip selection"

config RTL8328
	bool "RTL8328"
	help
	  Select the option to build RTL8328-based solution.

config RTL8380
	bool "RTL8380"
	help
	  Select the option to build RTL8380-based solution.

config RTL8390
	bool "RTL8390"
	help
	  Select the option to build RTL8390-based solution.
endchoice

choice
	prompt "System software solution"

config TURNKEY_SOLUTION
	bool "Turnkey solution"
	help
	  Select the option to build the turnkey solution.

config SDK_SOLUTION
	bool "SDK solution"
	help
	  Select the option to build the SDK solution.
endchoice

comment 'System common settings'
config SINGLE_FLASH_SIZE_GT4MB
	bool "Single flash chip size is larger than 4MB"
    default n
	help
	Select the option to set the flash per chip size.

config PER_FLASH_BLOCK_SIZE
	hex "Flash block size"
	default "0x10000"
	help
	Select the option to set the flash block size.

config FPGA_PLATFORM
	bool "FPGA platform"
	help
	  Select the option to set the environment on FPGA platform.

comment 'Turnkey common setting'
	depends on TURNKEY_SOLUTION

choice
	prompt "Turnkey model selection"
	depends on TURNKEY_SOLUTION
	help
	  Choose the turnkey model.

config TURNKEY_REALTEK
	bool "REALTEK"
	help
	  Realtek generic demo system.

endchoice

#comment 'Turnkey model specific setting'
#	depends on TURNKEY_SOLUTION

if TURNKEY_SOLUTION

config SKI
	tristate "Switch system kernel interface"
	help
	  Select the option to turn on System Kernel Interface.

menu "Switch user interface applications"

config WEBUI
	bool "Web Management Interface"
	help
	Choose to turn on Web Management Interface.

config CLI
	bool "Command Line Interface"
	help
	Choose to turn on Command Line Interface.

config SNMP
	bool "SNMP Agent"
	help
	Choose to turn on SNMP Agent.

endmenu #"Switch user interface applications"

menu "Switch features"

config ACL
    bool "Access control list"
    help
    Choose to turn on UI for Access Control List.
      
config BANDWIDTH_UTILIZATION
	bool "Bandwidth utilization"
	default y
	help
	Display per port TX/RX bandwidth utilization in Web UI.

config CABLE_DIAGNOSTIC
	bool "Cable diagnostic"
	help
	Detect the cable length and connection state.

config DEFENCE_ENGINE
	bool "Defence engine"
	default y
	help
	Throttle the egress bandwidth of CPU port.

config EVENT_LOGGING
    bool "Event logging"
    help
    Save spacific events in different log targets.

config FIRMWARE_SIGNATURE_CHECK
	bool "Firmware signature check"
	default y
	help
	Select the option to check firmware signature.

config FLOWTABLE
    bool "Flow table"
    help
    Choose to turn on UI for Flow Table.

config HTTP_UPGRADE
	bool "HTTP upgrade"
	help
	Upgrade image and configuration restore/backup through HTTP.

config PORT_ISOLATION
	bool "Port isolation"
	default y
	help
	Select the option to enable port isolation support.
	
config PORT_SECURITY
	bool "Port security"
	default y
	help
	Select the option to enable L2 limit entry support.

config SMI_ACCESS
	bool "SMI and GPIO driver"
	default y
	help
	Select the option to enable SMI and GPIO driver support.

config FIBER_HIGH_PRIORITY
    bool "Fiber high priority"
    depends on SMI_ACCESS
    default y
    help
    Fiber would take over the link while transceiver is plugged.

config GREEN_ETHERNET
	bool "Green ethernet"
	depends on SMI_ACCESS
	default y
	help
	enable Green Ethernet feature.

config POE
    bool "Power over ethernet"
    depends on SMI_ACCESS
    help
    Power Over Ethernet feature.

config SNMPV3
    bool "SNMPv3"
    help
    Choose to support SNMPv3.
      	
config TIME_SETTING
	bool "Time setting"
	default y
	help
	Select the option to enable Time Setting support.

config VLAN_STACKING
	bool "VLAN stacking"
	default y
	help
	Select the option to enable Q-in-Q support.

endmenu #"Switch features"

menu "Switch layer-2 protocols"

config L2GLUE_DRIVER
	tristate "Switch layer-2 glue driver"
	help
	Switch layer-2 glue driver.

config 8021X
	tristate "802.1x"
	depends on L2GLUE_DRIVER
	help
	IEEE 802.1X port-based Network Access Control.
	
config IGMP_SNOOPING
	tristate "IGMP snooping"
	depends on L2GLUE_DRIVER
	help
	IGMP Snooping Protocol.

config IGMP_SNOOPING_QUERIER
	tristate "IGMP querier"
	depends on IGMP_SNOOPING
	help
	IGMP Querier Feature.

config LACP
	tristate "LACP"
	depends on L2GLUE_DRIVER
	help
	IEEE 802.3ad Link Aggregation Control Protocol.

config LLDP
    tristate "LLDP"
    depends on L2GLUE_DRIVER
	help
    IEEE 802.1AD Link Layer Discovery Protocol.

config RSTP
	tristate "STP/RSTP"
	depends on L2GLUE_DRIVER
	help
	IEEE 802.1w Rapid Spanning Tree.

endmenu #"Switch layer-2 protocols"

endif

endmenu #"Realtek software solution"
```

## target/linux/realtek/files-6.6/Documentation/devicetree/bindings/mtd/realtek,rtl8197f-spirom.yaml
```yaml
# SPDX-License-Identifier: (GPL-2.0-only OR BSD-2-Clause)
%YAML 1.2
---
$id: http://devicetree.org/schemas/mtd/realtek,rtl8197f-spirom.yaml#
$schema: http://devicetree.org/meta-schemas/core.yaml#

title: Realtek RTL8197F/RTL8197FH SPI-NOR auto-map MTD window

maintainers:
  - OpenWrt RTL8197F bringup <noreply@example.invalid>

description: |
  MTD map over the RTL8197F SPI-NOR automatic read window. Array reads use the
  bootloader-programmed mapping and avoid active JEDEC/SFDP probing. Boards may
  optionally expose the controller resource and a strictly bounded writable
  window. The driver accepts program and erase operations only inside that
  window, allowing a dedicated rootfs_data partition to remain writable while
  boot, calibration, kernel and squashfs partitions stay read-only.

properties:
  compatible:
    enum:
      - realtek,rtl8197f-spirom
      - realtek,rtl8197fh-spirom

  reg:
    minItems: 1
    maxItems: 2

  reg-names:
    minItems: 1
    items:
      - const: automap
      - const: controller

  clocks:
    maxItems: 1
    description: SPI controller clock, required when a writable window is used.

  label: true

  erase-size:
    $ref: /schemas/types.yaml#/definitions/uint32
    description: Erase block size exposed to MTD.

  bank-width:
    $ref: /schemas/types.yaml#/definitions/uint32

  realtek,read-shift:
    $ref: /schemas/types.yaml#/definitions/uint32
    maximum: 3
    description: Byte offset compensation for boards whose auto-map reads are shifted.

  realtek,writable-offset:
    $ref: /schemas/types.yaml#/definitions/uint32
    description: First flash byte accepted by program and erase callbacks.

  realtek,writable-size:
    $ref: /schemas/types.yaml#/definitions/uint32
    description: Size of the only writable flash window.

  realtek,spi-clock-div:
    $ref: /schemas/types.yaml#/definitions/uint32
    minimum: 2
    maximum: 65535
    description: Conservative controller clock divider for write and erase commands.

patternProperties:
  '^partitions$':
    type: object

required:
  - compatible
  - reg

allOf:
  - if:
      required:
        - realtek,writable-offset
    then:
      required:
        - realtek,writable-size
        - reg-names
        - clocks
      properties:
        reg:
          minItems: 2
        reg-names:
          minItems: 2
  - if:
      required:
        - realtek,writable-size
    then:
      required:
        - realtek,writable-offset

additionalProperties: false

examples:
  - |
    flash@10000000 {
        compatible = "realtek,rtl8197f-spirom";
        reg = <0x10000000 0x01000000>, <0x18143000 0x1000>;
        reg-names = "automap", "controller";
        clocks = <&lx_clk>;
        label = "rtl8197f-spirom";
        erase-size = <0x10000>;
        realtek,read-shift = <1>;
        realtek,writable-offset = <0x00e60000>;
        realtek,writable-size = <0x001a0000>;
        realtek,spi-clock-div = <8>;
    };
...
```

## target/linux/realtek/files-6.6/Documentation/devicetree/bindings/pci/realtek,rtl8197f-pcie.yaml
```yaml
# SPDX-License-Identifier: (GPL-2.0-only OR BSD-2-Clause)
%YAML 1.2
---
$id: http://devicetree.org/schemas/pci/realtek,rtl8197f-pcie.yaml#
$schema: http://devicetree.org/meta-schemas/core.yaml#

title: Realtek RTL8197F PCI Express host controller

maintainers:
  - OpenWrt RTL8197F port <noreply@example.invalid>

description: |
  The RTL8197F/RTL8197FH family contains a single-lane PCIe root complex with
  separate root-complex and directly connected endpoint configuration windows.
  The controller has one physical slot and no MSI support in the vendor BSP.

allOf:
  - $ref: /schemas/pci/pci-host-bridge.yaml#

properties:
  compatible:
    const: realtek,rtl8197f-pcie

  reg:
    minItems: 2
    maxItems: 2

  reg-names:
    items:
      - const: rc
      - const: ep

  realtek,syscon:
    $ref: /schemas/types.yaml#/definitions/phandle
    description: Phandle of the RTL8197F system-register syscon.

  realtek,refclk-40mhz:
    type: boolean
    description: Select the GPL BSP's 40 MHz PCIe PHY MDIO tuning table.

  realtek,rtl8197f-vg:
    type: boolean
    description: Apply the RTL8197FH/VG-specific PCIe PHY register-8 value.

  interrupts:
    maxItems: 1

  bus-range:
    maxItems: 1

required:
  - compatible
  - reg
  - reg-names
  - realtek,syscon
  - interrupts
  - ranges

unevaluatedProperties: false

examples:
  - |
    pcie@18b00000 {
        compatible = "realtek,rtl8197f-pcie";
        device_type = "pci";
        reg = <0x18b00000 0x10000>, <0x18b10000 0x10000>;
        reg-names = "rc", "ep";
        realtek,syscon = <&syscon>;
        interrupts = <5>;
        #address-cells = <3>;
        #size-cells = <2>;
        bus-range = <0 0>;
        ranges = <0x01000000 0 0 0x18c00000 0 0x00200000>,
                 <0x02000000 0 0 0x19000000 0 0x01000000>;
    };
```
