## RTL8197F_RD05_AC23_MW5_OpenWrt24.10_PortKit_v1/01_OpenWrt_24.10/family_v35/openwrt24.10-realtek-linux-6.6.114-rtl8197f-rtl8367-family-v35/target/linux/realtek/files-6.6/Documentation/devicetree/bindings/net/realtek,rtl8197f-rtknet.yaml
```yaml
# SPDX-License-Identifier: (GPL-2.0-only OR BSD-2-Clause)
%YAML 1.2
---
$id: http://devicetree.org/schemas/net/realtek,rtl8197f-rtknet.yaml#
$schema: http://devicetree.org/meta-schemas/core.yaml#

title: Realtek RTL8197x rtl865x Ethernet CPU interface

maintainers:
  - OpenWrt RTL8197F bringup <noreply@example.invalid>

description: |
  Native Linux net_device/NAPI binding for the RTL8197x rtl865x CPU-interface
  DMA block. External RTL8367 family switches are described as separate DSA
  switch nodes whose CPU port references this Ethernet controller.

allOf:
  - $ref: ethernet-controller.yaml#
  - not:
      required:
        - realtek,rtl8367-dsa-master
        - realtek,rtl8367-legacy-master

properties:
  compatible:
    oneOf:
      - items:
          - enum:
              - realtek,rtl8197d-rtknet
              - realtek,rtl8197f-rtknet
              - realtek,rtl8197fh-rtknet
              - realtek,rtl8197g-rtknet
          - const: realtek,rtl865x-cpuif
      - const: realtek,rtl865x-cpuif

  reg:
    minItems: 1
    maxItems: 3

  reg-names:
    minItems: 1
    items:
      - const: cpuif
      - const: swcore
      - const: system

  interrupts:
    maxItems: 1

  clocks:
    maxItems: 1

  phy-mode: true

  local-mac-address: true
  mac-address: true

  realtek,rx-ring-size:
    $ref: /schemas/types.yaml#/definitions/uint32
    minimum: 16
    maximum: 512
    default: 64
    description: Number of receive descriptors.

  realtek,tx-ring-size:
    $ref: /schemas/types.yaml#/definitions/uint32
    minimum: 16
    maximum: 512
    default: 64
    description: Number of transmit descriptors.

  realtek,rx-buffer-size:
    $ref: /schemas/types.yaml#/definitions/uint32
    minimum: 1536
    maximum: 16384
    default: 2048
    description: Size of each receive DMA buffer.

  realtek,tx-port-mask:
    $ref: /schemas/types.yaml#/definitions/uint32
    minimum: 1
    maximum: 127
    default: 127
    description: |
      rtl865x descriptor destination-port mask used for transmitted frames.
      RTL8197F boards with an RTL8367D on physical P0/RGMII, including RD05,
      use BIT(0).  BIT(6) selects an internal rtl865x extension path instead.

  realtek,tx-dp-ext:
    $ref: /schemas/types.yaml#/definitions/uint32
    minimum: 0
    maximum: 7
    default: 0
    description: |
      rtl865x descriptor destination extension selector.  It is meaningful
      only when a SoC design intentionally targets the internal extension
      destination (normally tx-port-mask BIT(6)).  It must be zero for the
      RD05 RTL8197F-P0 to RTL8367D-EXT1 RGMII cascade.

  realtek,tx-extspa:
    $ref: /schemas/types.yaml#/definitions/uint32
    minimum: 0
    maximum: 3
    default: 0
    description: |
      rtl865x descriptor source extension-port number.  CPU-originated frames
      on the RD05 physical P0/RGMII path use zero; values 1..3 are diagnostic
      or apply to other rtl865x extension-port topologies.

  realtek,rtl8367-dsa-master:
    type: boolean
    description: |
      Select the RTL8197F physical P0/RGMII cascade datapath for an external
      RTL8367-family DSA switch. The driver uses direct destination port bit 0,
      preserves the 8-byte rtl8_4 CPU tag, enables the 8-dword descriptor
      format and SDK CPU-interface/SWCORE start sidebands, and seeds only the
      RTL8197F-internal host-link tables. The external switch CPU port is
      described independently in its DSA node. Mutually exclusive with
      realtek,rtl8367-legacy-master.

  realtek,rtl8367-legacy-master:
    type: boolean
    description: |
      Select the same RTL8197F physical P0/RGMII cascade datapath for the
      older OpenWrt swconfig rtl8367/rtl8367b drivers. The RTL8197F CPU-tag
      parser remains disabled because those drivers do not use the in-band
      rtl8_4 DSA tag. This mode exists for old B-map silicon whose large,
      revision-specific initialization tables are not safely represented by
      the Linux 6.6 DSA driver. Mutually exclusive with rtl8367-dsa-master.

  realtek,p0-rgmii-tx-delay:
    $ref: /schemas/types.yaml#/definitions/uint32
    minimum: 0
    maximum: 1
    default: 0
    description: RTL8197F P0 transmit-delay tap. The SDK default is zero.

  realtek,p0-rgmii-rx-delay:
    $ref: /schemas/types.yaml#/definitions/uint32
    minimum: 0
    maximum: 7
    default: 5
    description: |
      RTL8197F P0 receive-delay tap. Generic RTL8197F plus RTL8367 designs
      start at SDK tap 5. RTL8197FH-VG/RD05 uses tap 6 from the vendor BSP and
      hardware-log tuning. Override only after board signal-integrity tests.

  realtek,p0-rgtxc:
    $ref: /schemas/types.yaml#/definitions/uint32
    minimum: 0
    maximum: 3
    default: 3
    description: RTL8197F P0 RGTXC clock selection. The SDK default is 3.

  realtek,tx-hwlookup:
    type: boolean
    description: Let the rtl865x hardware lookup table select TX destinations.

  realtek,tx-bridge:
    type: boolean
    description: Set the rtl865x TX descriptor bridge bit.

  realtek,desc-addr-kseg1:
    type: boolean
    description: Program descriptor and buffer pointers in the KSEG1-like format used by the vendor BSP.

  realtek,desc-addr-physical:
    type: boolean
    description: Program descriptor and buffer pointers as physical addresses.

  realtek,legacy-rd05-sdk-pipeline:
    type: boolean
    description: |
      Seed the RTL8197F internal VID9, netif, L2 and ACL host-link state. The
      host member is physical P0 only; external RTL8367 user ports remain
      owned by DSA or swconfig. Generic boards derive table MAC entries from
      the netdev address; RD05 retains its measured OEM bootstrap values.
      Enabled automatically by either RTL8367 external-master mode.

  realtek,p0-cpu-tag-pass-through:
    type: boolean
    description: |
      Recognize protocol-4 Realtek CPU-tagged frames on RTL8197F physical P0
      without stripping the 8-byte tag, so the Linux rtl8_4 DSA tagger can
      decode the source port. Enabled automatically by rtl8367-dsa-master.

  realtek,rx-poll-fallback:
    type: boolean
    description: |
      Periodically schedule NAPI even when the CPU-interface IRQ line does not
      report RX events. This is an RD05 bring-up fallback observed to be needed
      when RTL8367D ingress MIB counters increase but the rtl865x CPU-interface
      receives no RX IRQ.

  realtek,rx-poll-ms:
    $ref: /schemas/types.yaml#/definitions/uint32
    minimum: 10
    maximum: 1000
    default: 100
    description: RX-poll fallback interval in milliseconds.

  realtek,sdk-cpuicr1-init:
    type: boolean
    description: |
      Apply the RTL8197F SDK CPU-interface setup bits in CPUICR1: split TX/RX
      LX bus, little-endian NIC master mode, TSO ID selection, TX gather and
      queue-ID to RX-ring-0 mapping. Required on RD05 where the DMA rings can
      otherwise remain idle even though NAPI is polled.

  realtek,sdk-trxrdy:
    type: boolean
    description: |
      Assert the rtl865x switch-core SIRR/TRXRDY bit through the optional
      swcore register range. In the Realtek SDK this bit is located at
      SWCORE_BASE + 0x4204, not in the normal SYSTEM register window.

  realtek,sdk-swcore-init:
    type: boolean
    description: |
      Apply the RTL8197F-VG switch-core side CPU-interface setup from the SDK:
      MACCTRL1.CMAC_CLK_SEL, SYS_CLK_MAG LX clock/arbiter bits and the
      TXRINGCR ring0/ring1 enable/backpressure/round-robin value.

  realtek,sdk-crc-lengths:
    type: boolean
    description: |
      Match the RTL8197F SDK descriptor-length convention: CPUICR.EXCLUDE_CRC
      is clear, TX descriptor lengths include four FCS bytes generated by
      hardware, and RX descriptor lengths include four FCS bytes that Linux
      strips before delivering the skb.

required:
  - compatible
  - reg
  - interrupts

unevaluatedProperties: false

examples:
  - |
    ethernet@10000 {
        compatible = "realtek,rtl8197f-rtknet", "realtek,rtl865x-cpuif";
        reg = <0x10000 0x1000>, <0x03800000 0x10000>, <0x0 0x4000>;
        reg-names = "cpuif", "swcore", "system";
        interrupt-parent = <&intc>;
        interrupts = <15 2>;
        clocks = <&lx_clk>;
        phy-mode = "rgmii";
        realtek,rx-ring-size = <64>;
        realtek,tx-ring-size = <64>;
        realtek,rx-buffer-size = <2048>;
        realtek,rtl8367-dsa-master;
        realtek,p0-rgmii-tx-delay = <0>;
        realtek,p0-rgmii-rx-delay = <5>;
        realtek,p0-rgtxc = <3>;
        realtek,tx-port-mask = <0x1>;
        realtek,tx-dp-ext = <0x0>;
        realtek,tx-extspa = <0x0>;
        realtek,desc-addr-kseg1;
        realtek,rx-poll-fallback;
        realtek,rx-poll-ms = <50>;
        realtek,sdk-cpuicr1-init;
        realtek,sdk-swcore-init;
        realtek,sdk-trxrdy;
        realtek,sdk-crc-lengths;
    };
...
```

## configs/rtl8197f_iball_wrd12gn_defconfig
```kconfig
CONFIG_TARGET_realtek=y
CONFIG_TARGET_realtek_rtl8197f=y
CONFIG_TARGET_MULTI_PROFILE=y
CONFIG_TARGET_PER_DEVICE_ROOTFS=y
CONFIG_TARGET_DEVICE_realtek_rtl8197f_DEVICE_iball_wrd12gn=y
```

## configs/rtl8197f_mw5_defconfig
```kconfig
CONFIG_TARGET_realtek=y
CONFIG_TARGET_realtek_rtl8197f=y
CONFIG_TARGET_realtek_rtl8197f_DEVICE_tenda_nova_mw5=y
CONFIG_TARGET_SQUASHFS_BLOCK_SIZE=1024
CONFIG_DRIVER_11AC_SUPPORT=y
# MW5 appliance/minimal profile
# CONFIG_IPV6 is not set
# CONFIG_PACKAGE_opkg is not set
# CONFIG_PACKAGE_apk-mbedtls is not set
# CONFIG_PACKAGE_ppp is not set
# CONFIG_PACKAGE_ppp-mod-pppoe is not set
# CONFIG_PACKAGE_odhcp6c is not set
# CONFIG_PACKAGE_odhcpd-ipv6only is not set
# CONFIG_PACKAGE_luci is not set
# CONFIG_PACKAGE_rpcd is not set
# CONFIG_PACKAGE_uhttpd-mod-ubus is not set

# MW5 uses its dedicated mw5-wifi/hostapd/nl80211 control path.
CONFIG_PACKAGE_iw=y
CONFIG_PACKAGE_wireless-regdb=y
# CONFIG_PACKAGE_iwinfo is not set
# CONFIG_PACKAGE_wifi-scripts is not set
```

## openwrt24.10-realtek-rtl8197f-mw5/configs/rtl8197f_ac23_defconfig
```kconfig
CONFIG_TARGET_realtek=y
CONFIG_TARGET_realtek_rtl8197f=y
CONFIG_TARGET_realtek_rtl8197f_DEVICE_tenda_ac23=y
```

## openwrt24.10-realtek-rtl8197f-mw5/configs/rtl8197f_all_devices_defconfig
```kconfig
CONFIG_TARGET_realtek=y
CONFIG_TARGET_realtek_rtl8197f=y
CONFIG_TARGET_MULTI_PROFILE=y
CONFIG_TARGET_PER_DEVICE_ROOTFS=y
CONFIG_TARGET_DEVICE_realtek_rtl8197f_DEVICE_xiaomi_r4_rd05=y
CONFIG_TARGET_DEVICE_realtek_rtl8197f_DEVICE_tenda_nova_mw5=y
CONFIG_TARGET_DEVICE_realtek_rtl8197f_DEVICE_tenda_ac23=y
```

## openwrt24.10-realtek-rtl8197f-mw5/configs/rtl8197f_mw5_defconfig
```kconfig
CONFIG_TARGET_realtek=y
CONFIG_TARGET_realtek_rtl8197f=y
CONFIG_TARGET_realtek_rtl8197f_DEVICE_tenda_nova_mw5=y
CONFIG_TARGET_SQUASHFS_BLOCK_SIZE=1024
```

## openwrt24.10-realtek-rtl8197f-mw5/configs/rtl8197f_rd05_defconfig
```kconfig
CONFIG_TARGET_realtek=y
CONFIG_TARGET_realtek_rtl8197f=y
CONFIG_TARGET_realtek_rtl8197f_DEVICE_xiaomi_r4_rd05=y
```

## openwrt24.10-realtek-rtl8197f-mw5/target/linux/realtek/files-6.6/Documentation/devicetree/bindings/gpio/realtek,rtl8197f-gpio.yaml
```yaml
# SPDX-License-Identifier: (GPL-2.0-only OR BSD-2-Clause)
%YAML 1.2
---
$id: http://devicetree.org/schemas/gpio/realtek,rtl8197f-gpio.yaml#
$schema: http://devicetree.org/meta-schemas/core.yaml#

title: Realtek RTL8197F/RTL8197FH GPIO controller

maintainers:
  - OpenWrt RTL8197F bringup <noreply@example.invalid>

properties:
  compatible:
    enum:
      - realtek,rtl8197f-gpio
      - realtek,rtl8197fh-gpio

  reg:
    maxItems: 1

  gpio-controller: true

  '#gpio-cells':
    const: 2

  ngpios:
    minimum: 1
    maximum: 64

  interrupt-controller: true

  '#interrupt-cells':
    const: 2

  interrupt-parent: true

  interrupts:
    minItems: 1
    maxItems: 2
    description: GPIO bank interrupt lines from the RTL8197F interrupt controller.

required:
  - compatible
  - reg
  - gpio-controller
  - '#gpio-cells'
  - ngpios

additionalProperties: false

examples:
  - |
    gpio-controller@3500 {
        compatible = "realtek,rtl8197f-gpio";
        reg = <0x3500 0x38>;
        gpio-controller;
        #gpio-cells = <2>;
        ngpios = <64>;
        interrupt-controller;
        #interrupt-cells = <2>;
        interrupt-parent = <&intc>;
        interrupts = <16 2>, <17 2>;
    };
...
```

## rtk-ms-uClinux-src-2.6.19-2.6.32.58-svn53590.tar.gz_extracted/kernel/uClinux/linux-2.6.32.x/arch/mips/Kconfig.mips
```kconfig
#
# Realtek Semiconductor Corp.
#
# RLX Linux Kernel Configuration
#
# Tony Wu (tonywu@realtek.com)
# Dec. 07, 2008
#

source "../target/selection/config.cpu"
source "../target/selection/config.in"

#
# MIPS
#
config MACH_MIPS
	bool
	default y
	select SYS_HAS_CPU_MIPS32_R2
	select SYS_HAS_EARLY_PRINTK
	select CPU_SUPPORTS_32BIT_KERNEL
	select SYS_SUPPORTS_32BIT_KERNEL
	select SYS_SUPPORTS_LITTLE_ENDIAN if ARCH_CPU_EL
	select SYS_SUPPORTS_BIG_ENDIAN if ARCH_CPU_EB
	select IRQ_CPU if ARCH_IRQ_CPU
	select IRQ_GIC if ARCH_IRQ_GIC
	select CPU_MIPSR2_IRQ_VI if ARCH_IRQ_VI
	select CPU_MIPSR2_IRQ_EI if ARCH_IRQ_EI
	select HW_HAS_PCI if (ARCH_BUS_PCI && BSP_ENABLE_PCI)
	select HW_HAS_USB if (ARCH_BUS_USB && BSP_ENABLE_USB)
	select ARCH_SUPPORTS_MSI if (ARCH_BUS_PCI_MSI && BSP_ENABLE_PCI)
	select DMA_NONCOHERENT
	select CEVT_R4K if ARCH_CEVT_R4K
	select CSRC_R4K if ARCH_CEVT_R4K
	select CEVT_EXT if ARCH_CEVT_EXT

#
# CPU
#
config CPU_MIPS4K
	bool
	default y if ARCH_CPU_MIPS4K

config CPU_MIPS24K
	bool
	default y if ARCH_CPU_MIPS24K

config CPU_MIPS34K
	bool
	default y if ARCH_CPU_MIPS34K
	select SYS_SUPPORTS_MULTITHREADING
	select CPU_HAS_MIPSMT

config CPU_MIPS74K
	bool
	default y if ARCH_CPU_MIPS74K

config CPU_MIPS1004K
	bool
	default y if ARCH_CPU_MIPS1004K
	select SYS_SUPPORTS_SMP
	select SYS_SUPPORTS_MULTITHREADING
	select SYS_SUPPORTS_MIPS_CMP
	select CPU_HAS_MIPSMT

config CPU_MIPS1074K
        bool
	default y if ARCH_CPU_MIPS1074K
	select SYS_SUPPORTS_SMP
	select SYS_SUPPORTS_MIPS_CMP

#
# CPU features
#
config CPU_HAS_FPU
	bool
	default y if (ARCH_CPU_HAS_FPU && BSP_ENABLE_FPU)

config CPU_USE_FPU
	bool
	default y if (CPU_HAS_FPU || MIPS_FPU_EMU)

config CPU_HAS_TLS
	bool
	default y if BSP_ENABLE_TLS

config CPU_USE_TLS
	bool
	default y if CPU_HAS_TLS

config CPU_HAS_DSP
	bool
	default y if (ARCH_CPU_HAS_DSP && BSP_ENABLE_DSP)

config CPU_USE_DSP
	bool
	default y if CPU_HAS_DSP

config CPU_HAS_MIPSMT
	bool

config CPU_USE_MIPSMT
	bool
	default y if (CPU_HAS_MIPSMT && !MIPS_MT_DISABLED)

config CPU_HAS_MIPS16
	bool
	default y

config CPU_USE_MIPS16
	bool
	default y if ARCH_CPU_HAS_MIPS16

config CPU_HAS_MDMX
	bool
	default n

config CPU_HAS_DIVEC
	bool
	default y

#
# Timer
#
config CEVT_EXT
	bool

#
# CACHE
#
config CPU_HAS_SPRAM
	bool
	default y if ARCH_CACHE_SPRAM

config CPU_HAS_WBC
	bool
	default y if ARCH_CACHE_WBC

config CPU_HAS_L2C
	bool
	default y if ARCH_CACHE_L2C

config CPU_HAS_AR7
	bool
	default y if ARCH_CACHE_AR7

#
# BUS
#
config HW_HAS_USB
	bool
```
